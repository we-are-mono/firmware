## layers/meta-mono/recipes-kernel/linux/files/defconfig
```kconfig
# Core system configuration
CONFIG_SYSVIPC=y
CONFIG_POSIX_MQUEUE=y
CONFIG_AUDIT=y
CONFIG_NO_HZ_IDLE=y
CONFIG_HIGH_RES_TIMERS=y
CONFIG_PREEMPT=y
CONFIG_IRQ_TIME_ACCOUNTING=y
CONFIG_IKCONFIG=y
CONFIG_IKCONFIG_PROC=y
CONFIG_BLK_DEV_INITRD=y
CONFIG_KALLSYMS_ALL=y

# Core module support
CONFIG_MODULES=y
CONFIG_MODULE_FORCE_LOAD=y
CONFIG_MODULE_UNLOAD=y
CONFIG_MODULE_FORCE_UNLOAD=y
CONFIG_MODVERSIONS=y
CONFIG_MODULE_SRCVERSION_ALL=y

# Automatic module loading
CONFIG_KMOD=y

# Module compression (choose one, saves space)
# CONFIG_MODULE_COMPRESS_NONE=y
CONFIG_MODULE_COMPRESS_GZIP=y
# CONFIG_MODULE_COMPRESS_XZ=y
# CONFIG_MODULE_COMPRESS_ZSTD=y

# Built-in initramfs (compression) support
CONFIG_INITRAMFS_SOURCE=""
CONFIG_INITRAMFS_ROOT_UID=0
CONFIG_INITRAMFS_ROOT_GID=0
CONFIG_INITRAMFS_COMPRESSION_GZIP=y
CONFIG_RD_GZIP=y

# RAM disk support
CONFIG_BLK_DEV_RAM=y
CONFIG_BLK_DEV_RAM_COUNT=16
CONFIG_BLK_DEV_RAM_SIZE=65536

# Essential filesystems for initramfs
CONFIG_TMPFS=y
CONFIG_SHMEM=y
CONFIG_PROC_FS=y
CONFIG_SYSFS=y
CONFIG_DEVTMPFS=y
CONFIG_DEVTMPFS_MOUNT=y

# Process accounting and control groups (for systemd)
CONFIG_BSD_PROCESS_ACCT=y
CONFIG_CGROUPS=y
CONFIG_MEMCG=y
CONFIG_BLK_CGROUP=y
CONFIG_CGROUP_PIDS=y
CONFIG_CGROUP_RDMA=y
CONFIG_CGROUP_FREEZER=y
CONFIG_CGROUP_DEVICE=y
CONFIG_CGROUP_CPUACCT=y
CONFIG_CGROUP_BPF=y
CONFIG_CGROUP_SCHED=y
CONFIG_FAIR_GROUP_SCHED=y
CONFIG_CFS_BANDWIDTH=y

# Namespaces and user management (for systemd)
CONFIG_NAMESPACES=y
CONFIG_USER_NS=y
CONFIG_NET_NS=y
CONFIG_PID_NS=y
CONFIG_IPC_NS=y
CONFIG_UTS_NS=y
CONFIG_SCHED_AUTOGROUP=y

# System call requirements for systemd
CONFIG_SIGNALFD=y
CONFIG_TIMERFD=y
CONFIG_EVENTFD=y
CONFIG_EPOLL=y
CONFIG_FHANDLE=y
CONFIG_INOTIFY_USER=y
CONFIG_FANOTIFY=y
CONFIG_CHECKPOINT_RESTORE=y

# Build optimizations
CONFIG_CC_OPTIMIZE_FOR_SIZE=y
CONFIG_EXPERT=y
CONFIG_SLUB_TINY=y

# Additional options from lsdk.config
CONFIG_LOCALVERSION_AUTO=y
CONFIG_SLAB=y
CONFIG_PID_IN_CONTEXTIDR=y
CONFIG_PROC_KCORE=y

# Kernel compression (choose one)
CONFIG_KERNEL_GZIP=y
# CONFIG_KERNEL_LZ4=y    # Faster decompression, less compression
# CONFIG_KERNEL_XZ=y     # Better compression, slower decompression
# CONFIG_KERNEL_ZSTD=y   # Good balance of size and speed

# Performance monitoring
CONFIG_PERF_EVENTS=y

# ARM64 CPU errata workarounds (Cortex-A72 specific)
CONFIG_ARM64_ERRATUM_826319=y
CONFIG_ARM64_ERRATUM_827319=y
CONFIG_ARM64_ERRATUM_824069=y
CONFIG_ARM64_ERRATUM_819472=y
CONFIG_ARM64_ERRATUM_832075=y
CONFIG_ARM64_ERRATUM_834220=y
CONFIG_ARM64_ERRATUM_845719=y
CONFIG_ARM64_ERRATUM_843419=y

# Essential ARM64 platform support for QEMU virt machine
CONFIG_ARM_GIC=y
CONFIG_ARM_GIC_V3=y
CONFIG_ARM_ARCH_TIMER=y
CONFIG_ARM_ARCH_TIMER_EVTSTREAM=y

# EFI support (QEMU virt machine provides UEFI)
CONFIG_EFI=y
CONFIG_EFI_STUB=y

# VirtIO drivers (essential for QEMU)
CONFIG_VIRTIO=y
CONFIG_VIRTIO_PCI=y
CONFIG_VIRTIO_MMIO=y
CONFIG_VIRTIO_NET=y
CONFIG_VIRTIO_BLK=y
CONFIG_VIRTIO_CONSOLE=y

# Console support
CONFIG_VT=y
CONFIG_VT_CONSOLE=y

# LS1046A/Layerscape specific
CONFIG_ARCH_NXP=y
CONFIG_ARCH_LAYERSCAPE=y
CONFIG_SCHED_MC=y
CONFIG_NUMA=y

# CPU frequency scaling for QorIQ
CONFIG_CPU_FREQ=y
CONFIG_CPU_FREQ_STAT=y
CONFIG_CPU_FREQ_GOV_ONDEMAND=y
CONFIG_CPU_FREQ_GOV_CONSERVATIVE=m
CONFIG_CPUFREQ_DT=y
CONFIG_QORIQ_CPUFREQ=y

# Power management
CONFIG_PM_DEBUG=y
CONFIG_WQ_POWER_EFFICIENT_DEFAULT=y
CONFIG_ENERGY_MODEL=y
CONFIG_ARM_PSCI_CPUIDLE=y

# Virtualization
CONFIG_VIRTUALIZATION=y
CONFIG_KVM=y
CONFIG_VHOST_NET=y
CONFIG_KVM_ARM_MAX_VCPUS=8

# Memory management
CONFIG_MEMORY_HOTPLUG=y
CONFIG_MEMORY_HOTREMOVE=y
CONFIG_TRANSPARENT_HUGEPAGE=y

# Networking
CONFIG_NET=y
CONFIG_PACKET=y
CONFIG_UNIX=y
CONFIG_UNIX_DIAG=y
CONFIG_INET=y
CONFIG_IP_MULTICAST=y
CONFIG_IP_PNP=y
CONFIG_IP_PNP_DHCP=y
CONFIG_IP_PNP_BOOTP=y
CONFIG_IPV6=y

# Enhanced networking from lsdk.config
CONFIG_NET_DSA=y
CONFIG_NET_DSA_MSCC_FELIX=y
CONFIG_INET_ESP=y
CONFIG_XFRM_USER=y
CONFIG_NET_KEY=y
CONFIG_IPV6_SIT=y
CONFIG_VLAN_8021Q=y
CONFIG_VLAN_8021Q_GVRP=y
CONFIG_VLAN_8021Q_MVRP=y
CONFIG_BRIDGE=y
CONFIG_MACVLAN=y
CONFIG_MACVTAP=y
CONFIG_MACSEC=y
CONFIG_TLS=y
CONFIG_TLS_DEVICE=y

# Enhanced netfilter from lsdk.config
CONFIG_NETFILTER=y
CONFIG_NETFILTER_ADVANCED=y
CONFIG_BRIDGE_NETFILTER=y
CONFIG_NETFILTER_NETLINK=y
CONFIG_NETFILTER_XTABLES=y
CONFIG_NETFILTER_XT_CONNMARK=y
CONFIG_NETFILTER_XT_TARGET_CONNMARK=y
CONFIG_NETFILTER_XT_NAT=y
CONFIG_NETFILTER_XT_MATCH_COMMENT=y
CONFIG_NF_CONNTRACK=y
CONFIG_NF_CONNTRACK_MARK=y
CONFIG_NF_CONNTRACK_PROCFS=y
CONFIG_NF_CONNTRACK_FTP=m
CONFIG_NF_CONNTRACK_TFTP=m
CONFIG_NF_NAT=y
CONFIG_NF_NAT_NEEDED=y
CONFIG_NF_NAT_FTP=m
CONFIG_NF_NAT_TFTP=m
CONFIG_NF_TABLES=y
CONFIG_NFT_CT=y
CONFIG_NFT_RBTREE=y
CONFIG_NFT_MASQ=y
CONFIG_NFT_NAT=y
CONFIG_NFT_COMPAT=y
CONFIG_NF_DEFRAG_IPV4=y
CONFIG_NF_CONNTRACK_IPV4=y
CONFIG_NF_CONNTRACK_PROC_COMPAT=y
CONFIG_NF_TABLES_IPV4=y
CONFIG_NF_NAT_IPV4=y
CONFIG_NF_NAT_MASQUERADE_IPV4=y
CONFIG_IP_NF_IPTABLES=y
CONFIG_IP_NF_FILTER=y
CONFIG_IP_NF_NAT=y
CONFIG_IP_NF_TARGET_MASQUERADE=y
CONFIG_IP_NF_MANGLE=y
CONFIG_NF_TABLES_BRIDGE=y
CONFIG_BRIDGE_NF_EBTABLES=y
CONFIG_BRIDGE_EBT_T_NAT=y
CONFIG_BRIDGE_EBT_DNAT=y
CONFIG_BRIDGE_EBT_SNAT=y
CONFIG_NF_NAT_IPV6=y
CONFIG_NF_NAT_MASQUERADE_IPV6=y
CONFIG_NF_REJECT_IPV6=y
CONFIG_NF_LOG_IPV6=y
CONFIG_NF_CONNTRACK_IPV6=y
CONFIG_NF_TABLES_IPV6=y

# Docker support from lsdk.config
CONFIG_NF_TABLES_INET=y
CONFIG_NF_TABLES_NETDEV=y
CONFIG_NFT_COUNTER=m
CONFIG_NF_DUP_NETDEV=m
CONFIG_NFT_DUP_NETDEV=m
CONFIG_NFT_FWD_NETDEV=m

# Basic netfilter (updated)
CONFIG_TUN=y

# Network diagnostics
CONFIG_NETLINK_DIAG=y
CONFIG_PACKET_DIAG=y

# Connector and PCI support
CONFIG_CONNECTOR=y
CONFIG_PCI=y
CONFIG_PCIEPORTBUS=y
CONFIG_PCIEAER=y
CONFIG_PCI_IOV=y
CONFIG_HOTPLUG_PCI=y
CONFIG_PCI_LAYERSCAPE=y

# WiFi and BT support (M.2 slots)
CONFIG_CFG80211=m
CONFIG_MAC80211=m
CONFIG_MAC80211_LEDS=y
CONFIG_BT=m
CONFIG_BT_RFCOMM=m
CONFIG_BT_RFCOMM_TTY=y
CONFIG_BT_BNEP=m
CONFIG_BT_HIDP=m
CONFIG_BT_HCIUART=m
CONFIG_BT_HCIUART_H4=y
CONFIG_BT_HCIUART_LL=y
CONFIG_BT_HCIBTUSB=m
CONFIG_BT_BTNXPUART=m
CONFIG_SERIAL_DEV_BUS=y

# WiFi drivers for common M.2 modules
CONFIG_IWLWIFI=m
CONFIG_IWLDVM=m
CONFIG_IWLMVM=m
CONFIG_ATH10K=m
CONFIG_ATH10K_PCI=m
CONFIG_MT7921E=m

# Device support and NXP/Freescale drivers
CONFIG_DEVTMPFS=y
CONFIG_DEVTMPFS_MOUNT=y
CONFIG_FW_LOADER_USER_HELPER=y
CONFIG_DEVPTS_MULTIPLE_INSTANCES=y
CONFIG_ARM_SCMI_PROTOCOL=y
CONFIG_FSL_MC_UAPI_SUPPORT=y

# MTD for flash storage
CONFIG_MTD=y
CONFIG_MTD_CMDLINE_PARTS=y
CONFIG_MTD_BLOCK=y
CONFIG_MTD_CFI=y
CONFIG_MTD_CFI_INTELEXT=y
CONFIG_MTD_CFI_AMDSTD=y
CONFIG_MTD_NAND_FSL_IFC=y
CONFIG_MTD_SPI_NOR=y

# Block devices and SCSI disk support
CONFIG_BLK_DEV_LOOP=y
CONFIG_BLK_DEV_SD=y
CONFIG_BLK_DEV_THROTTLING=y
CONFIG_CFQ_GROUP_IOSCHED=y

# MMC/eMMC support
CONFIG_MMC=y
CONFIG_MMC_BLOCK=y
CONFIG_MMC_SDHCI=y
CONFIG_MMC_SDHCI_PLTFM=y
CONFIG_MMC_SDHCI_OF_ESDHC=y

# Network devices - NXP/Freescale specific (DPAA1 only on LS1046A)
CONFIG_NETDEVICES=y
CONFIG_FSL_PQ_MDIO=y
CONFIG_FSL_XGMAC_MDIO=y
CONFIG_FEC=y
CONFIG_FSL_DPAA_1588=y

# Note: LS1046A has DPAA1, not DPAA2
# FSL_DPAA2_ETH is not applicable to LS1046A

# Hardware monitoring sensors
CONFIG_SENSORS_LM75=y
CONFIG_SENSORS_INA2XX=y
CONFIG_SENSORS_EMC2103=y

# Common PHYs for Layerscape (changed to module per NXP)
CONFIG_AQUANTIA_PHY=y
CONFIG_MARVELL_PHY=m
CONFIG_MARVELL_10G_PHY=y
CONFIG_REALTEK_PHY=y
CONFIG_DP83867_PHY=y
CONFIG_VITESSE_PHY=y
CONFIG_MAXLINEAR_GPHY=y

# SFP+ Module Framework Support
CONFIG_SFP=y
CONFIG_PHYLINK=y
CONFIG_PHY_FSL_LYNX_10G=y
CONFIG_PHY_FSL_LYNX_28G=y
CONFIG_MTIP_BACKPLANE_PHY=y

# Hardware monitoring and thermal management
CONFIG_HWMON=y
CONFIG_SENSORS_SFF8472=y
CONFIG_SENSORS_LM75=y
CONFIG_SENSORS_INA2XX=y
CONFIG_SENSORS_EMC2103=y
CONFIG_THERMAL_HWMON=y
CONFIG_THERMAL_WRITABLE_TRIPS=y
CONFIG_CPU_THERMAL=y
CONFIG_QORIQ_THERMAL=m
CONFIG_PHYLIB=y
CONFIG_MDIO_DEVICE=y
CONFIG_MDIO_BUS=y
CONFIG_MDIO_I2C=y
CONFIG_BCM87XX_PHY=y          # Broadcom 10G PHYs
CONFIG_CORTINA_PHY=y          # Cortina 10G PHYs
CONFIG_TERANETICS_PHY=y       # Teranetics 10G PHYs
CONFIG_AT803X_PHY=y           # Atheros/Qualcomm PHYs
CONFIG_MICROSEMI_PHY=y        # Microsemi PHYs
CONFIG_BROADCOM_PHY=y         # Additional Broadcom PHYs
CONFIG_CICADA_PHY=y           # Cicada/Vitesse PHYs
CONFIG_DAVICOM_PHY=y          # Davicom PHYs
CONFIG_ICPLUS_PHY=y           # IC+ PHYs
CONFIG_LSI_ET1011C_PHY=y      # LSI ET1011C PHYs
CONFIG_LXT_PHY=y              # Intel LXT PHYs
CONFIG_NATIONAL_PHY=y         # National Semiconductor PHYs
CONFIG_QSEMI_PHY=y            # Quality Semiconductor PHYs
CONFIG_SMSC_PHY=y             # SMSC PHYs
CONFIG_STE10XP=y              # STMicroelectronics PHYs

# Network PTP, LED support, and additional network features
CONFIG_NETWORK_PHY_TIMESTAMPING=y
CONFIG_PTP_1588_CLOCK=y
CONFIG_LEDS_CLASS=y
CONFIG_LEDS_TRIGGERS=y
CONFIG_LEDS_TRIGGER_NETDEV=y
CONFIG_LEDS_GPIO=y
CONFIG_NEW_LEDS=y
CONFIG_NET_VENDOR_BROADCOM=y
CONFIG_NET_VENDOR_INTEL=y
CONFIG_NET_VENDOR_MELLANOX=y
CONFIG_GPIOLIB_IRQCHIP=y

# Additional I2C algorithms (some SFP+ modules are picky)
CONFIG_I2C_ALGOBIT=y

# Network flow control, advanced features, and router optimizations
CONFIG_NET_FLOW_LIMIT=y
CONFIG_NET_RX_BUSY_POLL=y
CONFIG_BQL=y
CONFIG_RPS=y
CONFIG_RFS_ACCEL=y
CONFIG_XPS=y
CONFIG_NET_SCH_FQ=y
CONFIG_NET_SCH_FQ_CODEL=y

# Multi-queue networking for 10G performance
CONFIG_NETDEV_MULTIPLE_TX_QUEUE=y
CONFIG_NETDEV_MULTIPLE_RX_QUEUE=y

# Forwarding plane optimizations
CONFIG_IP_ROUTE_MULTIPATH=y
CONFIG_IP_ROUTE_VERBOSE=y
CONFIG_IP_MROUTE=y
CONFIG_IP_MROUTE_MULTIPLE_TABLES=y
CONFIG_IP_PIMSM_V1=y
CONFIG_IP_PIMSM_V2=y
CONFIG_IPV6_ROUTER_PREF=y
CONFIG_IPV6_ROUTE_INFO=y
CONFIG_IPV6_OPTIMISTIC_DAD=y
CONFIG_IPV6_MULTIPLE_TABLES=y
CONFIG_IPV6_SUBTREES=y
CONFIG_IPV6_MROUTE=y
CONFIG_IPV6_MROUTE_MULTIPLE_TABLES=y
CONFIG_IPV6_PIMSM_V2=y

# ECMP support for load balancing
CONFIG_IP_ROUTE_MULTIPATH=y

# Enhanced packet scheduling for routing
CONFIG_NET_SCH_PRIO=y
CONFIG_NET_SCH_RED=y
CONFIG_NET_SCH_SFQ=y
CONFIG_NET_SCH_TEQL=y
CONFIG_NET_SCH_TBF=y
CONFIG_NET_SCH_HTB=y
CONFIG_NET_SCH_HFSC=y

# Policy routing
CONFIG_IP_ADVANCED_ROUTER=y
CONFIG_IP_MULTIPLE_TABLES=y
CONFIG_IP_ROUTE_MULTIPATH=y

# IPsec offload for DPAA2
CONFIG_XFRM_OFFLOAD=y
CONFIG_INET_ESP_OFFLOAD=y
CONFIG_INET6_ESP_OFFLOAD=y

# Additional debugging for SFP+ issues (disabled in production)
# CONFIG_DEBUG_GPIO is not set
# CONFIG_I2C_DEBUG_CORE is not set
# CONFIG_I2C_DEBUG_ALGO is not set

# Ensure proper thermal monitoring for high-power SFP+ modules
CONFIG_THERMAL_HWMON=y

# Additional network optimizations for 10G
CONFIG_XPS=y
CONFIG_RPS=y
CONFIG_RFS_ACCEL=y
CONFIG_NET_SCHED=y
CONFIG_NET_SCH_FQ=y
CONFIG_NET_SCH_FQ_CODEL=y

# Hardware timestamping for PTP (critical for SFP+ synchronization)
CONFIG_NETWORK_PHY_TIMESTAMPING=y
CONFIG_PTP_1588_CLOCK=y
CONFIG_PTP_1588_CLOCK_QORIQ=y
CONFIG_DP83640_PHY=y

# DPAA1 Frame Manager support for LS1046A
CONFIG_FSL_FMAN_PORT=y

# IRQ affinity and CPU isolation for routing performance
CONFIG_IRQ_FORCED_THREADING=y
CONFIG_NO_HZ_FULL=y
CONFIG_CONTEXT_TRACKING_FORCE=y

# Reduce latency
CONFIG_PREEMPT_VOLUNTARY=y
CONFIG_HZ_1000=y
CONFIG_HZ=1000

# QoS and Traffic Shaping from lsdk.config (changed to module per NXP)
CONFIG_NETFILTER_INGRESS=y
CONFIG_NET_SCH_MULTIQ=m
CONFIG_NET_SCH_MQPRIO=m
CONFIG_NET_SCH_TAPRIO=m
CONFIG_NET_SCH_TBF=y
CONFIG_NET_CLS=y
CONFIG_NET_CLS_BASIC=m
CONFIG_NET_CLS_TCINDEX=m
CONFIG_NET_CLS_U32=y
CONFIG_NET_CLS_FLOWER=m
CONFIG_NET_EMATCH=y
CONFIG_NET_EMATCH_STACK=32
CONFIG_NET_EMATCH_U32=y
CONFIG_NET_CLS_ACT=y
CONFIG_NET_ACT_PEDIT=y
CONFIG_NET_ACT_SKBEDIT=y
CONFIG_NET_ACT_VLAN=y
CONFIG_NET_ACT_SKBMOD=y
CONFIG_NET_ACT_MIRRED=m
CONFIG_TSN=y

# Optional: Mellanox ConnectX support for their SFP+ modules
CONFIG_MLX4_EN=m
CONFIG_MLX5_CORE=m
CONFIG_MLX5_CORE_EN=y

# Optional: Intel ixgbe driver for Intel-based SFP+ modules (not needed for SFP+ router)
# CONFIG_IXGBE is not set

# Optional: Chelsio T4/T5 support (not needed for SFP+ router)
# CONFIG_CHELSIO_T4 is not set

# EEPROM and PHY support
CONFIG_EEPROM_AT24=y
CONFIG_EEPROM_93CX6=y
CONFIG_FIXED_PHY=y
CONFIG_GENERIC_PHY=y

# USB host support (minimal - router doesn't need full USB)
CONFIG_USB=y
CONFIG_USB_STORAGE=y
CONFIG_USB_XHCI_HCD=y

# USB network devices (disabled - not needed for router)
# CONFIG_USB_NET_DRIVERS is not set
# CONFIG_USB_RTL8152 is not set
# CONFIG_USB_USBNET is not set
# CONFIG_USB_NET_AX8817X is not set
# CONFIG_USB_NET_AX88179_178A is not set

# USB storage support
CONFIG_SCSI=y
CONFIG_BLK_DEV_SD=y
CONFIG_USB_UAS=y
CONFIG_EXFAT_FS=y

# Serial console
CONFIG_SERIAL_8250=y
CONFIG_SERIAL_8250_CONSOLE=y
CONFIG_SERIAL_8250_NR_UARTS=8
CONFIG_SERIAL_8250_EXTENDED=y
CONFIG_SERIAL_8250_DW=y
CONFIG_SERIAL_OF_PLATFORM=y

# AMBA PL011 serial (used by QEMU virt machine)
CONFIG_SERIAL_AMBA_PL011=y
CONFIG_SERIAL_AMBA_PL011_CONSOLE=y

# I2C support
CONFIG_I2C=y
CONFIG_I2C_CHARDEV=y
CONFIG_I2C_MUX=y
CONFIG_I2C_MUX_PCA954x=y
CONFIG_I2C_DESIGNWARE_PLATFORM=y
CONFIG_I2C_IMX=y

# SPI support
CONFIG_SPI=y
CONFIG_SPI_FSL_DSPI=y
CONFIG_SPI_FSL_QUADSPI=y
CONFIG_SPI_NXP_FLEXSPI=y

# GPIO
CONFIG_GPIOLIB=y
CONFIG_GPIO_SYSFS=y
CONFIG_GPIO_MPC8XXX=y
CONFIG_GPIO_SYSCON=y
CONFIG_GPIO_PCA953X=y

# RTC, watchdog, and hardware random number generator
CONFIG_RTC_CLASS=y
CONFIG_RTC_DRV_PCF2127=m
CONFIG_WATCHDOG=y
CONFIG_WATCHDOG_CORE=y
CONFIG_IMX2_WDT=y
CONFIG_HW_RANDOM=y

# DMA engines, clocks, regulators, and NVMEM
CONFIG_DMADEVICES=y
CONFIG_FSL_EDMA=y
CONFIG_FSL_QDMA=m
CONFIG_COMMON_CLK_SCMI=y
CONFIG_REGULATOR_FIXED_VOLTAGE=y
CONFIG_NVMEM_LAYERSCAPE_SFP=m

# Layerscape SoC drivers and IOMMU
CONFIG_FSL_MC_DPIO=y
CONFIG_FSL_RCPM=y
CONFIG_FSL_IFC=y
CONFIG_IOMMU_IO_PGTABLE_LPAE=y
CONFIG_IOMMU_DEFAULT_PASSTHROUGH=y
CONFIG_ARM_SMMU_DISABLE_BYPASS_BY_DEFAULT=n
# Disable the DPAA1 upstream driver - use SDK version instead
CONFIG_FSL_DPAA=n
CONFIG_FSL_FMAN=n
CONFIG_FSL_DPAA_ETH=n

# Enable the DPAA1 SDK driver (staging)
CONFIG_STAGING=y
CONFIG_FSL_SDK_DPA=y
CONFIG_FSL_SDK_FMAN=y
CONFIG_FSL_SDK_DPAA_ETH=y

# DPAA1 optimizations for routing workloads
CONFIG_FSL_SDK_FMAN_TEST=n
# Enable offline port support for USDPAA if needed
# CONFIG_FSL_DPAA_ETH_SG_SUPPORT=y
# CONFIG_FSL_DPAA_1588=y (already enabled above)
# CONFIG_FSL_DPAA_TS=y

# IOMMU support
CONFIG_IOMMU_IO_PGTABLE_LPAE=y
CONFIG_IOMMU_DEFAULT_PASSTHROUGH=y
CONFIG_ARM_SMMU_DISABLE_BYPASS_BY_DEFAULT=n

# UIO drivers from lsdk.config
CONFIG_UIO=y
CONFIG_UIO_CIF=y
CONFIG_UIO_PDRV_GENIRQ=y
CONFIG_UIO_DMEM_GENIRQ=y
CONFIG_UIO_AEC=y
CONFIG_UIO_SERCOS3=y
CONFIG_UIO_PCI_GENERIC=y
CONFIG_UIO_NETX=y
CONFIG_UIO_MF624=y

# BPF support from lsdk.config
CONFIG_BPF_SYSCALL=y
CONFIG_BPF_JIT_ALWAYS_ON=y
CONFIG_XDP_SOCKETS=y
CONFIG_SOCK_CGROUP_DATA=y

# File systems (changed to module per NXP)
CONFIG_EXT4_FS=y
CONFIG_EXT4_FS_POSIX_ACL=y
CONFIG_EXT4_FS_SECURITY=y
CONFIG_EXT2_FS_XATTR=y
CONFIG_EXT2_FS_POSIX_ACL=y
CONFIG_EXT3_FS_POSIX_ACL=y
CONFIG_VFAT_FS=y
CONFIG_TMPFS=y
CONFIG_TMPFS_POSIX_ACL=y
CONFIG_TMPFS_XATTR=y
CONFIG_CONFIGFS_FS=y
CONFIG_NFS_FS=y
CONFIG_NFS_V4=y
CONFIG_ROOT_NFS=y
CONFIG_HFSPLUS_FS=y
CONFIG_AUTOFS4_FS=y
CONFIG_BTRFS_FS=m
CONFIG_FUSE_FS=m
CONFIG_SQUASHFS_XZ=y
CONFIG_OVERLAY_FS=m

# Device mapper
CONFIG_DM_CRYPT=m

# Hugepage support for DPDK
CONFIG_HUGETLBFS=y
CONFIG_HUGETLB_PAGE=y
CONFIG_TRANSPARENT_HUGEPAGE=y
CONFIG_TRANSPARENT_HUGEPAGE_ALWAYS=y
CONFIG_TRANSPARENT_HUGEPAGE_MADVISE=y

# Crypto support for LS1046A (router with IPsec capabilities)
# LS1046A has SEC 5.4 (Security Engine) via CAAM
CONFIG_CRYPTO_USER=y
CONFIG_CRYPTO_ECHAINIV=y
CONFIG_CRYPTO_GHASH_ARM64_CE=y
CONFIG_CRYPTO_SHA1_ARM64_CE=y
CONFIG_CRYPTO_SHA2_ARM64_CE=y
CONFIG_CRYPTO_SHA256_ARM64=y
CONFIG_CRYPTO_SHA512_ARM64_CE=m
CONFIG_CRYPTO_AES_ARM64_CE_BLK=y
CONFIG_CRYPTO_AES_ARM64_CE_CCM=y
CONFIG_CRYPTO_AES_ARM64_BS=m
CONFIG_CRYPTO_CHACHA20_NEON=m

# FSL CAAM for LS1046A (not DPAA2 CAAM)
CONFIG_CRYPTO_DEV_FSL_CAAM=m
CONFIG_CRYPTO_DEV_FSL_CAAM_RINGSIZE=9
CONFIG_CRYPTO_DEV_FSL_CAAM_INTC=y
CONFIG_CRYPTO_DEV_FSL_CAAM_AHASH_API=m
CONFIG_CRYPTO_DEV_FSL_CAAM_PKC_API=m
CONFIG_CRYPTO_DEV_FSL_CAAM_RNG_API=m

# Additional crypto algorithms for VPN/IPsec
CONFIG_CRYPTO_AUTHENC=y
CONFIG_CRYPTO_CBC=y
CONFIG_CRYPTO_CTR=y
CONFIG_CRYPTO_GCM=y
CONFIG_CRYPTO_SEQIV=y
CONFIG_CRYPTO_DEFLATE=y
CONFIG_CRYPTO_LZO=y

# Debug support (minimal)
CONFIG_PRINTK_TIME=y
CONFIG_DEBUG_KERNEL=y
CONFIG_DEBUG_INFO_REDUCED=y
CONFIG_MAGIC_SYSRQ=y
CONFIG_DEBUG_FS=y

# Disable unnecessary debug features
# CONFIG_SCHED_DEBUG is not set
# CONFIG_DEBUG_PREEMPT is not set
# CONFIG_FTRACE is not set

# Disable unneeded options from lsdk.config
# CONFIG_NET_VENDOR_STMICRO is not set
# CONFIG_MEDIA_SUPPORT is not set
# CONFIG_BACKLIGHT_GENERIC is not set
# CONFIG_TEGRA_HOST1X is not set
# CONFIG_BT is not set
# CONFIG_DRM_TEGRA is not set
# CONFIG_DRM_EXYNOS is not set
# CONFIG_DRM_MSM is not set
# CONFIG_DRM_VC4 is not set
# CONFIG_DRM_HISI_HIBMC is not set
# CONFIG_DRM_HISI_KIRIN is not set
# CONFIG_DRM_MESON is not set
# CONFIG_DRM_ROCKCHIP is not set
# CONFIG_DRM_RCAR_DU is not set
# CONFIG_USB_RENESAS_USBHS is not set
# CONFIG_QCOM_EMAC is not set
# CONFIG_SND_SOC_ROCKCHIP is not set
# CONFIG_NET_PKTGEN is not set

# Performance optimization: reduce CPU count for NXP platforms
CONFIG_NR_CPUS=16
```
