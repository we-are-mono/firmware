## layers/meta-mono/conf/distro/gateway.conf
```bitbake
DISTRO = "gateway"
DISTRO_NAME = "Mono Gateway Linux Distribution"
DISTRO_VERSION = "1.0"
MAINTAINER = "Tomaz Zaman <tomaz@mono.si>"

DISTRO_FEATURES = "systemd usrmerge"

# Use systemd for service management (better for complex systems)
VIRTUAL-RUNTIME_init_manager = "systemd"
VIRTUAL-RUNTIME_initscripts = "systemd-compat-units"

# Use BusyBox for basic utilities
VIRTUAL-RUNTIME_base-utils = "util-linux"
VIRTUAL-RUNTIME_login_manager = "shadow-base"

# Minimal C library
TCLIBC = "glibc"
```

## layers/meta-mono/conf/layer.conf
```bitbake
# We have a conf and classes directory, add to BBPATH
BBPATH .= ":${LAYERDIR}"

# We have recipes-* directories, add to BBFILES
BBFILES += "${LAYERDIR}/recipes-*/*/*.bb \
            ${LAYERDIR}/recipes-*/*/*.bbappend"

BBFILE_COLLECTIONS += "mono"
BBFILE_PATTERN_mono = "^${LAYERDIR}/"
BBFILE_PRIORITY_mono = "6"

LAYERDEPENDS_mono = "core"
LAYERSERIES_COMPAT_mono = "styhead"
```

## layers/meta-mono/conf/machine/gateway-dk.conf
```bitbake
#@TYPE: Machine
#@NAME: Gateway Development Kit
#@DESCRIPTION: Machine configuration for Gateway Development Kit with LS1046A CPU

# CPU Architecture and tuning
require conf/machine/include/arm/armv8a/tune-cortexa72.inc

# Basic info about the hardware
MACHINE_FEATURES = "usbhost pci rtc serial"

# Support both real hardware (ttyS0) and QEMU (ttyAMA0)
SERIAL_CONSOLES = "115200;ttyS0 115200;ttyAMA0"

# Kernel configuration
PREFERRED_PROVIDER_virtual/kernel = "linux-mono"
KERNEL_IMAGETYPE = "Image.gz"

# We want to build initramfs, which will be embedded into Kernel binary.
# If you want to build the kernel and rootfs separately, comment it out.
INITRAMFS_IMAGE = "mono-image"

# Allow larger initramfs (8MB limit)
INITRAMFS_MAXSIZE = "8388608"
```
